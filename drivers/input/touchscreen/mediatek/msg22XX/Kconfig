## drivers/input/touchscreen/mediatek/msg22XX/Kconfig
```kconfig
#
# Touchscreen driver configuration
#
if TOUCHSCREEN_MTK_MSG22XX

config MSG22XX_CONFIG
	string "MSG22XX for Mediatek config"

endif
```

## drivers/misc/mediatek/sensors-1.0/accelerometer/mxc622x/Kconfig
```kconfig
config MTK_MXC622X
	bool "MXC622X for MediaTek package"
	default n
	help
	  It support different accelerometer sensor.
          If this option is set,
	  it will support
          MXC6225XU Accelerometer.
```
